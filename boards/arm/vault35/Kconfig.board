## boards/arm/vault35/Kconfig.defconfig
```kconfig
if BOARD_VAULT35

config BOARD
    default "vault35"
    depends on SOC_RP2040

config ZMK_KEYBOARD_NAME
    default "Vault 35"

config RP2_FLASH_W25Q080
	default y
    
endif
```

## boards/arm/vault35/vault35_defconfig
```kconfig
CONFIG_SOC_SERIES_RP2XXX=y
CONFIG_SOC_RP2040=y
CONFIG_SYS_CLOCK_HW_CYCLES_PER_SEC=125000000
CONFIG_GPIO=y
CONFIG_SERIAL=y
CONFIG_RESET=y
CONFIG_CONSOLE=y
CONFIG_UART_CONSOLE=y
CONFIG_USE_DT_CODE_PARTITION=y
CONFIG_BUILD_OUTPUT_UF2=y

# Turn on logging, and set ZMK logging to debug output
CONFIG_ZMK_USB_LOGGING=y

# ZMK Settings
CONFIG_ZMK_USB=y
CONFIG_ZMK_KSCAN_MATRIX_POLLING=y

# CONFIG_EC11=y
# CONFIG_EC11_TRIGGER_GLOBAL_THREAD=y
```
