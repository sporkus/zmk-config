/*
 * Copyright (c) 2020 The ZMK Contributors
 *
 * SPDX-License-Identifier: MIT
 */

#include <behaviors.dtsi>
#include <dt-bindings/zmk/keys.h>

#include "./zmk-nodefree-config/helper.h"
#include "./zmk-nodefree-config/keypos_def/keypos_34keys.h"
#include "./base.keymap"


/* overrides */
/ {
    chosen {
        zmk,matrix_transform = &transform_with_encoder;

    };
};

&encoder {
    status = "okay";
};

&sensors {
    status = "okay";
};

/* keymap 
Layers are either two or three args:
- ZMK_LAYER(layer_name, keys)
- ZMK_LAYER(layer_name, keys, encoder_funcs)

Each layer needs an unique name
*/

ZMK_LAYER(default_layer, ALL_34_KEYS(_DEF)   &kp C_MUTE, VOL_KNOB)
ZMK_LAYER(num_layer,     ALL_34_KEYS(_NUM)   ___)
ZMK_LAYER(nav_layer,     ALL_34_KEYS(_NAV)   ___)
ZMK_LAYER(fun_layer,     ALL_34_KEYS(_FUN)   ___)


