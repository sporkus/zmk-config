#define DEF 0
#define NUM 1
#define NAV 2
#define FUN 3


/* Behaviors */
#define QUICK_TAP_MS 220

ZMK_BEHAVIOR(hrm, hold_tap, \
    flavor = "balanced"; \
    tapping-term-ms = <280>; \
    quick-tap-ms = <QUICK_TAP_MS>; \
    require-prior-idle-ms = <200>; \
    bindings = <&kp>, <&kp>; \
    hold-trigger-on-release; \
)

ZMK_BEHAVIOR(sft, hold_tap,
    flavor = "hold-preferred";
    tapping-term-ms = <280>;
    quick-tap-ms = <200>;
    bindings = <&kp>, <&kp>;
    hold-while-undecided;
)

ZMK_BEHAVIOR(ltt, hold_tap,
    flavor = "tap-preferred";
    tapping-term-ms = <280>;
    quick-tap-ms = <QUICK_TAP_MS>; \
    require-prior-idle-ms = <150>; \
    bindings = <&mo>, <&kp>;
)

ZMK_BEHAVIOR(lth, hold_tap,
    flavor = "hold-preferred";
    tapping-term-ms = <280>;
    quick-tap-ms = <QUICK_TAP_MS>;
    bindings = <&mo>, <&kp>;
)

&key_repeat {
    usage-pages = <HID_USAGE_KEY HID_USAGE_CONSUMER>;
};

&caps_word {
    continue-list = <UNDERSCORE MINUS BSPC>;
};

/* Mod morphs
Need to reference them using node name instead of the regular keycodes
e.g. &comm_semi instead of &kp COMMA
*/
ZMK_MODMORPH_SFT(comm_semi,      &kp COMMA,     &kp SEMI)
ZMK_MODMORPH_SFT(dot_colon,      &kp DOT,       &kp COLON)
ZMK_MODMORPH_SFT(rlbrc,          &kp RBRC,      &kp LBRC)
ZMK_MODMORPH_SFT(rlpar,          &kp RPAR,      &kp LPAR)
ZMK_MODMORPH_SFT(rlbkt,          &kp RBKT,      &kp LBKT)
//ZMK_MODMORPH_CTL(q_af4,          &kp Q,         &kp LA(F4))
ZMK_MODMORPH_GUI(no_win_l,       &hrm LALT L,   &none)

/* Layer helpers */

#define XXX &none
#define ___ &trans
#define num_spc lth NUM SPACE
#define nav_spc ltt NAV SPACE
#define VOL_KNOB &inc_dec_kp C_VOL_DN C_VOL_UP


/* Define

/* --------------|---------------|---------------|---------------|---------------||||---------------|---------------|---------------|---------------|--------------- */
#define _DEF \
&kp Q,            &kp W,        &kp E,           &kp R,          &kp T,             &kp Y,          &kp U,          &kp I,          &kp O,          &kp P, \
&hrm LSHFT A,     &hrm LALT S,   &hrm LGUI D,     &hrm LCTRL F,   &kp G,             &kp H,          &hrm LCTRL J,   &hrm LGUI K,    &no_win_l,      &hrm LSHFT SQT, \
&sft LSHFT Z,     &kp X,         &kp C,           &kp V,          &kp B,             &kp N,          &kp M,          &comm_semi,     &dot_colon,     &sft RSHFT SLASH, \
                                                  &kp LCTRL,      &num_spc,          &nav_spc,       &kp LGUI
/* --------------|---------------|---------------|---------------|---------------||||---------------|---------------|---------------|---------------|--------------- */
#define _NUM \
&mo FUN,          ___,            ___,            ___,            ___,               &kp EQUAL,      &kp N7,         &kp N8,         &kp N9,         &kp N0, \
___,              ___,            ___,            ___,            ___,               &kp MINUS,      &kp N4,         &kp N5,         &kp N6,         &kp SEMI, \
___,              ___,            ___,            ___,            ___,               &kp GRAVE,      &kp N1,         &kp N2,         &kp N3,         &kp BSLH, \
                                                  ___,            ___,               ___,            ___
/* --------------|---------------|---------------|---------------|---------------||||---------------|---------------|---------------|---------------|--------------- */
#define _NAV \
&kp LG(GRAVE),    ___,            ___,            &key_repeat,    &kp LA(TAB),       ___,            ___,            ___,            ___,            &kp LC(BSPC), \
___,              ___,            ___,            ___,            ___,               &kp LEFT,       &kp DOWN,       &kp UP,         &kp RIGHT,      ___ , \
&kp LC(Z),        &kp LC(X),      &kp LC(INS),    &kp LS(INS),    ___,               ___,            &kp PG_DN,      &kp PG_UP,      &key_repeat,    ___ , \
                                                  ___,            ___,               ___,            ___
/* --------------|---------------|---------------|---------------|---------------||||---------------|---------------|---------------|---------------|--------------- */
#define _FUN \
___,              ___,            ___,            ___,            ___,               ___,            &kp F7,         &kp F8,         &kp F9,         &kp F10, \
___,              ___,            ___,            ___,            ___,               ___,            &kp F4,         &kp F5,         &kp F6,         &kp F11, \
___,              ___,            ___,            ___,            ___,               ___,            &kp F1,         &kp F2,         &kp F3,         &kp F12, \
                                                  ___,            ___,               ___,            ___
/* --------------|---------------|---------------|---------------|---------------||||---------------|---------------|---------------|---------------|--------------- */


/* Needs the inner macro to expand the arguments */
#define L_TOP_ROW(layer) L_TOP_ROW_INNER(layer)
#define R_TOP_ROW(layer) R_TOP_ROW_INNER(layer)
#define L_MID_ROW(layer) L_MID_ROW_INNER(layer)
#define R_MID_ROW(layer) R_MID_ROW_INNER(layer)
#define L_BOT_ROW(layer) L_BOT_ROW_INNER(layer)
#define R_BOT_ROW(layer) R_BOT_ROW_INNER(layer)
#define L_TMB1(layer) L_TMB1_INNER(layer)
#define L_TMB0(layer) L_TMB0_INNER(layer)
#define R_TMB0(layer) R_TMB0_INNER(layer)
#define R_TMB1(layer) R_TMB1_INNER(layer)
#define ALL_34_KEYS(layer) ALL_34_KEYS_INNER(layer)

#define L_TOP_ROW_INNER(K1, K2, K3, K4, K5, ...) K1 K2 K3 K4 K5
#define R_TOP_ROW_INNER(K1, K2, K3, K4, K5, K6, K7, K8, K9, K10, ...) K6 K7 K8 K9 K10
#define L_MID_ROW_INNER(K1, K2, K3, K4, K5, K6, K7, K8, K9, K10, K11, K12, K13, K14, K15, ...) K11 K12 K13 K14 K15
#define R_MID_ROW_INNER(K1, K2, K3, K4, K5, K6, K7, K8, K9, K10, K11, K12, K13, K14, K15, K16, K17, K18, K19, K20, ...) K16 K17 K18 K19 K20
#define L_BOT_ROW_INNER(K1, K2, K3, K4, K5, K6, K7, K8, K9, K10, K11, K12, K13, K14, K15, K16, K17, K18, K19, K20, K21, K22, K23, K24, K25, ...) K21 K22 K23 K24 K25
#define R_BOT_ROW_INNER(K1, K2, K3, K4, K5, K6, K7, K8, K9, K10, K11, K12, K13, K14, K15, K16, K17, K18, K19, K20, K21, K22, K23, K24, K25, K26, K27, K28, K29, K30, ...) K26 K27 K28 K29 K30
#define   L_TMB1_INNER(K1, K2, K3, K4, K5, K6, K7, K8, K9, K10, K11, K12, K13, K14, K15, K16, K17, K18, K19, K20, K21, K22, K23, K24, K25, K26, K27, K28, K29, K30, K31, K32, K33, K34) K31
#define   L_TMB0_INNER(K1, K2, K3, K4, K5, K6, K7, K8, K9, K10, K11, K12, K13, K14, K15, K16, K17, K18, K19, K20, K21, K22, K23, K24, K25, K26, K27, K28, K29, K30, K31, K32, K33, K34) K32
#define   R_TMB0_INNER(K1, K2, K3, K4, K5, K6, K7, K8, K9, K10, K11, K12, K13, K14, K15, K16, K17, K18, K19, K20, K21, K22, K23, K24, K25, K26, K27, K28, K29, K30, K31, K32, K33, K34) K33
#define   R_TMB1_INNER(K1, K2, K3, K4, K5, K6, K7, K8, K9, K10, K11, K12, K13, K14, K15, K16, K17, K18, K19, K20, K21, K22, K23, K24, K25, K26, K27, K28, K29, K30, K31, K32, K33, K34) K34
#define   ALL_34_KEYS_INNER(K1, K2, K3, K4, K5, K6, K7, K8, K9, K10, K11, K12, K13, K14, K15, K16, K17, K18, K19, K20, K21, K22, K23, K24, K25, K26, K27, K28, K29, K30, K31, K32, K33, K34) K1 K2 K3 K4 K5 K6 K7 K8 K9 K10 K11 K12 K13 K14 K15 K16 K17 K18 K19 K20 K21 K22 K23 K24 K25 K26 K27 K28 K29 K30 K31 K32 K33 K34

#include "combos.dtsi"  // requires layer aliases
